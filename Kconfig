## Kconfig
```kconfig
mainmenu "GPS Device Configuration"

menu "HW Modules"
	menu "Buttons"
		config BUTTON_MAX_OBJECTS
			int "Max number of button objects"
			range 1 5
			default 1

		config BUTTON_MAX_NAME_LEN
			int "Max button name length"
			range 1 32
			default 1
	endmenu

	menu "SD"
		config SD_MAX_OBJECTS
			int "Max number of SD objects"
			range 1 3
			default 1

		config SD_MAX_NAME_LEN
			int "Max SD name len"
			range 1 32
			default 10

		config SD_HW_INIT_WAIT_TIME
			int "Time for HW initialization (ms)"
			range 1 1000
			default 5

		config SD_R1_RESP_TIMEOUT
			int "Max time to receive an R1 response (ms)"
			range 1 1000
			default 5

		config SD_R1B_RESP_TIMEOUT
			int "Max time for MISO to be held down after an R1B response"
			range 1 1000
			default 50

		config SD_TIMEOUT_RETRY_NUM
			int "Max retries after a timeout has occured"
			range 1 50
			default 3

		config SD_INVALID_RESP_RETRY_NUM
			int "Max retries after not expected response is received"
			range 1 100
			default 10
	endmenu

	menu "SSD1309"

	endmenu

	menu "GTU7"
		config GTU7_MAX_TOKENS
			int "Max number of tokens in a NMEA message"
			range 1 30
			default 1
	endmenu
	
	menu "IO"
		config IO_MAX_OBJECTS
			int "Max number of IO objects"
			range 1 10
			default 1
		config IO_MAX_NAME_LEN
			int "Max IO name length"
			range 1 32
			default 1
	endmenu
endmenu

menu "System"
	menu "Peripherals"
		menu "GPIO"

		endmenu

		menu "I2C"

		endmenu

		menu "SPI"

		endmenu

		menu "TIM"

		endmenu

		menu "USART"

		endmenu
	endmenu
endmenu

menu "SW Modules"
	menu "Circular Buffer"
	
	endmenu

	menu "Command Interpreter"
		config CMD_MAX_CLIENTS
			int "Max number of clients"
			range 1 50
			default 1

		config CMD_MAX_TOKENS
			int "Max number of tokens in a command"
			range 1 20
			default 1

	endmenu

	menu "Serial Console"
		config CONSOLE_USART_CBUF_SIZE
			int "Size of the USART data receive circular buffer (must be 2^n)"
			range 1 64
			default 16

		config CONSOLE_CBUF_SIZE
			int "Size of the console circular buffer (must be 2^n)"
			range 1 128
			default 64
	endmenu

	menu "Logging"
	
	endmenu

	menu "Menu"
		config MENU_MAX_OBJECTS
			int "Max number of menu objects"
			range 1 10
			default 1

		config MENU_MAX_OPTIONS
			int "Max number of menu options"
			range 1 20
			default 1

		config MENU_MAX_BUF_SIZE
			int "Max number of menus in buffer"
			range 1 10
			default 1

		config MENU_MAX_NAME_LEN
			int "Max menu name length"
			range 1 20
			default 1
	endmenu
endmenu

config COMPILE_WITH_LOGGING
	bool "Compile with logging"
	default y

config VERSION
	string "Firmware version"
	default "0.1"
```
